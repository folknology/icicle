# socname register map
Vendor: vendor
Registers are 8-bit, read-write, reset 0x0 unless marked. A register's access mark holds for its fields unless they carry their own. Offsets are from the block's base; lines under a group give offsets from that group; [hi:lo] are bit positions; {n}, {i} and the like mark numbered series; 'fields as' and 'values as' point back to an identical list; <NAME> marks a mode.

## Memory map
0x80000000 leds
0x80000004 uart0

## leds
Base 0x80000000
0x00 _oe_csr — _oe_csr of csr
  [2:0] _oe_csr
0x01 _i_csr ro — _i_csr of csr
  [2:0] _i_csr
0x02 _o_csr — _o_csr of csr
  [2:0] _o_csr

## uart0
Base 0x80000004
0x00 _clk_div_csr 16-bit — _clk_div_csr of csr
0x02 _status_csr ro — _status_csr of csr
  [1:0] _status_csr
0x03 _data_csr — _data_csr of csr
